## harness/research/g2d/src/sun50i-g2d/Kconfig
```kconfig
# SPDX-License-Identifier: GPL-2.0-only
config VIDEO_SUN50I_G2D
	tristate "Allwinner H616 G2D colour conversion and scaling driver"
	depends on V4L_MEM2MEM_DRIVERS
	depends on VIDEO_DEV
	depends on ARCH_SUNXI || COMPILE_TEST
	depends on COMMON_CLK && OF
	depends on PM
	select VIDEOBUF2_DMA_CONTIG
	select V4L2_MEM2MEM_DEV
	help
	   Support for the mixer of the Allwinner G2D 2D graphics engine
	   found on the H616 as a V4L2 mem2mem colour conversion and
	   scaling device (RGB and YUV 4:2:0 / 4:2:2 formats).

	   To compile this driver as a module choose m here.
```
